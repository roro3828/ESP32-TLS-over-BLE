## components/tls_over_ble/Kconfig
```kconfig
menu "TLS over BLE"

    config TLS_OVER_BLE_SVC_UUID
        string "Tunnel service UUID"
        default "6e7a0001-7c3b-4f5e-9a1d-3b2f0c8e5a10"
        help
            128-bit UUID of the tunnel GATT service. Change it per product if needed;
            the central relay must use the same UUIDs.

    config TLS_OVER_BLE_RX_UUID
        string "RX characteristic UUID (central -> device)"
        default "6e7a0002-7c3b-4f5e-9a1d-3b2f0c8e5a10"

    config TLS_OVER_BLE_TX_UUID
        string "TX characteristic UUID (device -> central)"
        default "6e7a0003-7c3b-4f5e-9a1d-3b2f0c8e5a10"

    config TLS_OVER_BLE_CTRL_UUID
        string "Control characteristic UUID"
        default "6e7a0004-7c3b-4f5e-9a1d-3b2f0c8e5a10"

    config TLS_OVER_BLE_RX_BUFFER_SIZE
        int "Receive buffer size (bytes)"
        default 8192
        range 2048 65536
        help
            Allocated only while a session is open. Also the credit window the
            central may send ahead. Keep CONFIG_BT_NIMBLE_TRANSPORT_ACL_FROM_LL_COUNT
            above this size / (ATT MTU - 4) plus a margin (40 for 8192 and MTU 247),
            so that a full window never exhausts the HCI ACL buffers.

    config TLS_OVER_BLE_MSYS_RESERVE
        int "NimBLE mbuf blocks kept free for other services"
        default 4
        range 0 64
        help
            The tunnel stops queueing TX notifications while fewer than this many
            NimBLE mbuf blocks are free, so that other services (e.g. HID input
            reports) are not delayed. This bounds how much TX data is in flight.

    config TLS_OVER_BLE_FAST_CONN_PARAMS
        bool "Request a short connection interval and 2M PHY during a session"
        default y

    config TLS_OVER_BLE_TASK_STACK_SIZE
        int "Worker task stack size"
        default 6144
        help
            The worker sends control messages and calls the identity sign callback.

    config TLS_OVER_BLE_TASK_PRIORITY
        int "Worker task priority"
        default 5

    config TLS_OVER_BLE_TLS_LAYER
        bool "Include the TLS layer (ble_tls.h)"
        default y

    config TLS_OVER_BLE_SESSION_RESUMPTION
        bool "Keep one TLS 1.3 session ticket in RAM for resumption"
        depends on TLS_OVER_BLE_TLS_LAYER
        default y

    config TLS_OVER_BLE_ESP_TRANSPORT
        bool "esp_transport adapter (ble_tls_transport.h) for esp_http_client"
        depends on TLS_OVER_BLE_TLS_LAYER
        default y
        help
            Lets esp_http_client / esp_https_ota run over the tunnel. The app must
            also enable CONFIG_ESP_HTTP_CLIENT_ENABLE_CUSTOM_TRANSPORT.

endmenu
```

## main/Kconfig.projbuild
```kconfig
menu "Sample: BLE keyboard + TLS tunnel"

    config APP_DEVICE_NAME
        string "BLE device name"
        default "TLS over BLE"
        help
            Keep it at 18 characters or less so that it fits in the advertising packet.

    config APP_BUTTON_GPIO
        int "Button GPIO (active low)"
        default 41
        help
            AtomS3 Lite: GPIO41.

    config APP_TLS_DEMO
        bool "Run one HTTPS GET through the tunnel when the relay app connects"
        default y

    config APP_TLS_DEMO_HOST
        string "HTTPS demo host"
        depends on APP_TLS_DEMO
        default "example.com"

    config APP_TLS_DEMO_PORT
        int "HTTPS demo port"
        depends on APP_TLS_DEMO
        default 443

    config APP_TLS_DEMO_PATH
        string "HTTPS demo path"
        depends on APP_TLS_DEMO
        default "/"

    config APP_TLS_DEMO_RAW
        bool "Write the HTTP request directly with ble_tls (no esp_http_client)"
        depends on APP_TLS_DEMO
        default n
        help
            Off: the demo uses esp_http_client over the ble_tls esp_transport adapter.
            On: the older demo that writes the HTTP/1.1 request by hand.

    config APP_OTA_DEMO
        bool "Check for a firmware update through the tunnel when the relay app connects"
        default y
        help
            Downloads the image header from APP_OTA_URL with esp_https_ota over the
            tunnel. If its version differs from the running one, downloads the whole
            image, switches the boot partition and restarts.

    config APP_OTA_URL
        string "Firmware image URL"
        depends on APP_OTA_DEMO
        default "https://localhost:8443/firmware.bin"
        help
            The host and port must be on the central's allowlist
            (e.g. --allow localhost:8443 for tools/ota_server/ota_server.py).

    choice APP_OTA_CA
        prompt "Trusted CA for the update server"
        depends on APP_OTA_DEMO
        default APP_OTA_CA_EMBEDDED

        config APP_OTA_CA_EMBEDDED
            bool "Embedded main/ota_ca.pem (created by tools/ota_server/ota_server.py init)"
        config APP_OTA_CA_BUNDLE
            bool "ESP x509 certificate bundle (server with a public CA)"
    endchoice

endmenu
```
